//**************************************************
//
// Test of PWM Playtune library
//
// L. Shustek, 31 Jan 2011; initial release.
// L. Shustek, 27 Feb 2011; new score data
// L. Shustek, 6 April 2015; change for compatibility with Arduino IDE v1.6.x
// T. Wasiluk, 28 May 2016; moved to appropriate library examples subdirectory
// David Rubio, 9 September 2018; added support for the popular attiny85 based on L.Shustek attiny4313 menorah November 25, 2013
// David Rubio, 20 December 2018; modified the library so that it works with a PWM pin (pin 9) and it supports custom waveforms (for the atmega328p only) (it also supports LEDs per channel!!!)
//**************************************************

#include <PWM_Playtune.h>


/**********************************************************************
put down here your bytestream from miditones 
***********************************************************************/
// Playtune bytestream for file "friend_please.mid" created by MIDITONES V1.4 on Thu Jul 20 22:33:33 2017
const byte PROGMEM score [] = {
0x90,43, 0x91,62, 0x92,67, 0x93,71, 1,217, 0x80, 0,26, 0x90,50, 1,217, 0x80, 0,26, 0x90,55, 1,217, 0x80, 0,26, 
0x90,50, 1,217, 0x80, 0,26, 0x90,43, 1,217, 0x80, 0,26, 0x90,50, 1,217, 0x80, 0,26, 0x90,55, 1,217, 0x80, 
0,26, 0x90,50, 1,42, 0x81, 0x82, 0x83, 0,175, 0x80, 0,26, 0x90,62, 0x91,43, 0x92,67, 0x93,71, 1,217, 0x81, 0,26, 
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1,217, 0x80, 0,26, 0x90,86, 1,217, 0x80, 0,26, 0x90,91, 0,198, 0x81, 6,164, 0x80, 0xf0};
// This score contains 8797 bytes, and 6 tone generators are used.
// 3 notes had to be skipped.


const unsigned char PROGMEM score1 [] = {
  0x90, 63, 0, 192, 0x80, 0, 10, 0x90, 66, 0, 206, 0x80, 0, 10, 0x90, 63, 0, 199, 0x80, 0, 14, 0x90, 66, 0, 199, 0x80,
  0, 14, 0x90, 63, 0, 199, 0x80, 0, 14, 0x90, 66, 0, 206, 0x80, 0, 7, 0x90, 63, 0, 206, 0x80, 0, 10, 0x90, 66, 0, 203,
  0x80, 0, 10, 0x90, 59, 0, 203, 0x80, 0, 10, 0x90, 66, 0, 203, 0x80, 0, 10, 0x90, 59, 0, 203, 0x80, 0, 14, 0x90, 66,
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  0x91, 66, 0, 199, 0x81, 0xf0
};

// Playtune bytestream for file "air_catcher.mid" created by MIDITONES V1.4 on Sun Jul 30 19:30:13 2017
const byte PROGMEM score2 [] = {
0x90,0x2E, 0x91,0x49, 1,98, 0x80, 0,20, 0x90,0x35, 1,98, 0x80, 0,20, 0x90,0x3A, 1,61, 0x81, 
0,56, 0x80, 0,1, 0x90,0x41, 1,98, 0x80, 0,20, 0x90,0x46, 1,98, 0x80, 0,20, 0x90,0x49, 
4,43, 0x80, 0,57, 0x90,0x2C, 0x91,0x49, 1,98, 0x80, 0x81, 0,20, 0x90,0x35, 0x91,0x46, 1,98, 
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16,48, 0x80, 0x82, 0x84, 0x81, 0x83, 0x85, 0xf0};
// This score contains 10418 bytes, and 6 tone generators are used.
// 9 notes had to be skipped.

PWM_Playtune pt;
byte play;
byte prevplay;
void track(){
   
    play++; //toggle variable play
    if(play==3) play=0;
    while(digitalRead(3)==0) delay(50); //delay for debouncing    
    pt.tune_stopscore(); //stop the score
}
void setup() {


pinMode(3,INPUT_PULLUP); //activate internal pull up for pin 2
attachInterrupt(1,track,LOW); //attach an interrupt on pin 2

pt.begin(); //initialize the timers
pt.enable_leds(13,12,11,10); // call this function for using leds and give them the pins where they are going to be

}
int analog;
void loop () {
  if(play==0) pt.tune_playscore (score); //play score if play=0
  if(play==1) pt.tune_playscore (score1); //play score1 if play=1
  if(play==2) pt.tune_playscore (score2); //play score2 if play=2
  while (pt.tune_playing){
    if(analogRead(A1)<analog-4||analogRead(A1)>analog+4){
      byte v=map(analogRead(A1),0,1023,0,100); // set the volume between 0/100
     pt.set_volume(v); 
     analog=analogRead(A1);
    }
  }
  
  // wait here until playing stops 
  
          
}